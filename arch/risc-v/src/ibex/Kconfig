## arch/risc-v/src/ibex/Kconfig
```kconfig
#
# For a description of the syntax of this configuration file,
# see the file kconfig-language.txt in the NuttX tools repository.
#

comment "IBEX Configuration Options"

menu "IBEX Peripheral Support"

# These "hidden" settings determine whether a peripheral option is available
# for the selected MCU

config IBEX_HAVE_UART0
	bool
	default y
	select UART0_SERIALDRIVER
	select ARCH_HAVE_SERIAL_TERMIOS

# These are the peripheral selections proper

config IBEX_UART0
	bool "UART0"
	default y
	select ARCH_HAVE_UART0
	select ARCH_HAVE_SERIAL_TERMIOS
	select IBEX_UART

endmenu
```
